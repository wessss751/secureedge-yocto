## meta-secureedge-distro/conf/distro/secureedge.conf
```bitbake
require conf/distro/poky.conf

DISTRO = "secureedge"
DISTRO_NAME = "SecureEdge Linux"
DISTRO_VERSION = "1.0.0"
DISTRO_CODENAME = "industrial"

SDK_VENDOR = "-secureedge"
DISTRO_FEATURES:append = " systemd usrmerge"
DISTRO_FEATURES:remove = "sysvinit"

VIRTUAL-RUNTIME_init_manager = "systemd"
VIRTUAL-RUNTIME_initscripts = ""
VIRTUAL-RUNTIME_dev_manager = "systemd"
```

## meta-secureedge-distro/conf/layer.conf
```bitbake
BBPATH .= ":${LAYERDIR}"

BBFILES += "${LAYERDIR}/recipes-*/*/*.bb \
            ${LAYERDIR}/recipes-*/*/*.bbappend"

BBFILE_COLLECTIONS += "meta-secureedge-distro"
BBFILE_PATTERN_meta-secureedge-distro = "^${LAYERDIR}/"
BBFILE_PRIORITY_meta-secureedge-distro = "6"

LAYERDEPENDS_meta-secureedge-distro = "core"
LAYERSERIES_COMPAT_meta-secureedge-distro = "scarthgap"
```

## meta-secureedge-platform/conf/layer.conf
```bitbake
BBPATH .= ":${LAYERDIR}"

BBFILES += "${LAYERDIR}/recipes-*/*/*.bb \
            ${LAYERDIR}/recipes-*/*/*.bbappend"

BBFILE_COLLECTIONS += "meta-secureedge-platform"
BBFILE_PATTERN_meta-secureedge-platform = "^${LAYERDIR}/"
BBFILE_PRIORITY_meta-secureedge-platform = "6"

LAYERDEPENDS_meta-secureedge-platform = "core"
LAYERSERIES_COMPAT_meta-secureedge-platform = "scarthgap"
```

## meta-secureedge-platform/wic/secureedge-rauc-ab.wks
```
part --source bootimg-partition --ondisk mmcblk0 --fstype=vfat --label BOOTCTL --active --fixed-size 64 --align 4096

part --source bootimg-partition --ondisk mmcblk0 --fstype=vfat --label BOOT_A --fixed-size 192 --align 4096

part --source bootimg-partition --ondisk mmcblk0 --fstype=vfat --label BOOT_B --fixed-size 192 --align 4096


part / --source rootfs --ondisk mmcblk0 --fstype=ext4 --label ROOTFS_A --fixed-size 512 --align 4096 --no-fstab-update

part --source rootfs --ondisk mmcblk0 --fstype=ext4 --label ROOTFS_B --fixed-size 512 --align 4096 --no-fstab-update

part --ondisk mmcblk0 --fstype=ext4 --label DATA --fixed-size 1024 --align 4096

bootloader --ptable msdos
```
